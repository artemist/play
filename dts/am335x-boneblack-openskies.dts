// Compile with
// gcc -E -nostdinc -I $KERNELSRC -I $KERNELSRC/include -x assembler-with-cpp -o am335x-boneblack-openskies.dts.tmp am335x-boneblack-openskies.dts
// dtc -I dts -O dtb -@ -i $KERNELSRC -i $KERNELSRC/include -o am335x-boneblack-openskies.dtb am335x-boneblack-openskies.dts.tmp

#include <arch/arm/boot/dts/am335x-boneblack.dts>

&i2c1 {
	status = "okay";
	clock-frequency = <400000>;

};

&uart1 {
	status = "okay";
};


&uart2 {
	status = "okay";
};
